## boards/arm/corne_choc_pro/Kconfig.defconfig
```kconfig
# Copyright (c) 2020 The ZMK Contributors
# SPDX-License-Identifier: MIT

if BOARD_CORNE_CHOC_PRO_LEFT

config ZMK_KEYBOARD_NAME
	default "Corne Choc Pro"

config ZMK_SPLIT_ROLE_CENTRAL
    default y

endif # BOARD_CORNE_CHOC_PRO_LEFT

if BOARD_CORNE_CHOC_PRO_LEFT || BOARD_CORNE_CHOC_PRO_RIGHT 

config BOARD
    default "corne_choc_pro"

config ZMK_SPLIT
    default y

if USB

config USB_NRFX
	default y

config USB_DEVICE_STACK
	default y

endif # USB

config BT_CTLR
	default BT

config I2C
	default y

config ZMK_MAX17048
    default y

config ZMK_COMBO_MAX_COMBOS_PER_KEY
    default 16

config ZMK_COMBO_MAX_PRESSED_COMBOS
    default 4

config ZMK_COMBO_MAX_KEYS_PER_COMBO
    default 4

endif # BOARD_CORNE_CHOC_PRO_LEFT || BOARD_CORNE_CHOC_PRO_RIGHT
```
