/*
 * Corne Choc Pro BT, 46 keys. The keymap itself lives in corne.dtsi; the outer
 * columns are padded with &none to train the 36/40-key layout.
 *
 * SPDX-License-Identifier: MIT
 */

#include "key-labels.h"

#define LAYOUT(                                                                \
    t0, t1, t2, t3, t4, t5, t6, t7, t8, t9, t10, t11,                          \
    m0, m1, m2, m3, m4, m5, m6, m7, m8, m9, m10, m11,                          \
    b0, b1, b2, b3, b4, b5, b6, b7, b8, b9,                                    \
    h0, h1, h2, h3, h4, h5)                                                    \
    &none t0 t1 t2 t3 t4 t5 t6 t7 t8 t9 t10 t11 &none                          \
    &none m0 m1 m2 m3 m4 m5 m6 m7 m8 m9 m10 m11 &none                          \
    &none b0 b1 b2 b3 b4 b5 b6 b7 b8 b9 &none                                  \
    h0 h1 h2 h3 h4 h5

/ {
    chosen {
        zmk,physical-layout = &default_layout;
    };
};

#include "corne.dtsi"
